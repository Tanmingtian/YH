#include "stm32f4xx_it.h"
#include <stdio.h>
#include "motor.h"
#include "bsp.h"
#define ERR_INFO "\r\nEnter HardFault_Handler, System Halt.\r\n"
const unsigned int Speedup_moto[162]=
{2048,2033,2025,2017,2007,1996,1983,1970,1956,1940,1924,1907,1889,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556,556};
//{2048,2033,2025,2017,2007,1996,1983,1970,1956,1940,1924,1907,1889,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556,556};
//{2048,2045,2038,2026,2010,1990,1966,1940,1910,1879,1846,1812,1777,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556,556};
const unsigned int moto_ac[147]=
	{2048,2047,2047,2046,2045,2044,2042,2040,2038,2035,2032,2029,2026,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1158,1157};

volatile int LastCh=-1;
/*
*********************************************************************************************************
*	Cortex-M3 内核异常中断服务程序
*********************************************************************************************************
*/

/*
*********************************************************************************************************
*	函 数 名: NMI_Handler
*	功能说明: 不可屏蔽中断服务程序。
*	形    参: 无
*	返 回 值: 无
*********************************************************************************************************
*/
void NMI_Handler(void)
{
}

/*
*********************************************************************************************************
*	函 数 名: HardFault_Handler
*	功能说明: 硬件故障中断服务程序。其他异常处理被关闭，而又发生了异常，则触发。
*			  执行异常处理时，发生了异常，则触发。复位时默认使能。
*	形    参: 无
*	返 回 值: 无
*********************************************************************************************************
*/
void HardFault_Handler(void)
{
#if 1
  const char *pError = ERR_INFO;
  uint8_t i;

  for (i = 0; i < sizeof(ERR_INFO); i++)
  {
     USART1->DR = pError[i];
     /* 等待发送结束 */
     while ((USART1->SR & USART_FLAG_TC) == (uint16_t)RESET);
  }
#endif

  /* 当硬件失效异常发生时进入死循环 */
  while (1)
  {
  }
}

/*
*********************************************************************************************************
*	函 数 名: MemManage_Handler
*	功能说明: 内存管理异常中断服务程序。违反MPU设定的存储器访问规则时触发。 复位时默认未使能
*	形    参: 无
*	返 回 值: 无
*********************************************************************************************************
*/
void MemManage_Handler(void)
{
  /* 当内存管理异常发生时进入死循环 */
  while (1)
  {
  }
}

/*
*********************************************************************************************************
*	函 数 名: BusFault_Handler
*	功能说明: 总线访问异常中断服务程序。取指令、数据读写、堆栈操作出现异常。 复位时默认未使能
*	形    参: 无
*	返 回 值: 无
*********************************************************************************************************
*/
void BusFault_Handler(void)
{
  /* 当总线异常时进入死循环 */
  while (1)
  {
  }
}

/*
*********************************************************************************************************
*	函 数 名: UsageFault_Handler
*	功能说明: 用法错误中断服务程序。执行未定义指令、非对齐操作、除零时触发。 复位时默认未使能
*	形    参: 无
*	返 回 值: 无
*********************************************************************************************************
*/
void UsageFault_Handler(void)
{
  /* 当用法异常时进入死循环 */
  while (1)
  {
  }
}

/*
*********************************************************************************************************
*	函 数 名: DebugMon_Handler
*	功能说明: 调试监视器中断服务程序。
*	形    参: 无
*	返 回 值: 无
*********************************************************************************************************
*/
void DebugMon_Handler(void)
{
}

/*******************************************************************************
外部中断用于光电开关信号检测
*******************************************************************************/
void EXTI15_10_IRQHandler(void)
{
if(EXTI_GetITStatus(EXTI_LINE_TripSwitch) != RESET)
	{
		if(cw_status==BACKWARD)
		{
			//补足脉冲数
			PulseCount=PulseNum+AddedNum+500;
			//电机中断和定时器关闭
			TIM_ITConfig(TIM2, TIM_IT_Update, DISABLE);
			TIM_Cmd(TIM2,DISABLE);
			//关闭外部中断					 
			EXTI->IMR&=0xFFFFDFFF;
			TripSwitchStatus=1;
		}
		EXTI_ClearITPendingBit(EXTI_LINE_TripSwitch);
	}
}


//	BitAction f=0;

//切光片电机使用TIM1中断
void TIM5_IRQHandler(void)
{
	if(Step_LM<10000)	//加速过程
	{
		//清除中断标志
		TIM_ClearITPendingBit(TIM5, TIM_IT_Update);
		TIM5->ARR=(Speedup[(u8)((Step_LM++)/50)]<<1)-1;
	}
	else
	{					
		//转速达到启动PWM
		TIM_ITConfig(TIM5, TIM_IT_Update, DISABLE);
		TIM5->ARR=4499;
//		TIM5->CCER=0x000B;
//		TIM5->CNT=0x1193;//8b3
//		TIM5->ARR=3071;
//		TIM5->CCER=0x000B;
//		TIM5->CNT=0x08b3;
	}	 	
}


//AK5351中断
void SPI2_IRQHandler(void)
{
	u16 temp;
	//用于AK5351中断
	if (SPI_I2S_GetITStatus(SPI2, SPI_I2S_IT_RXNE) == SET)
	{
		temp=SPI_I2S_ReceiveData(SPI2);
		SPI_I2S_ClearITPendingBit(SPI2,SPI_I2S_IT_RXNE);
		if(LastCh<10)
		{			
			LastCh++;
			return;
		}
		if(RxLeftIdx==0 && RxRightIdx==0 && temp%0x100==0)
		{
			LastCh=11;
		}
		else if(LastCh==11)
		{ 
			//如果为左声道
			if(SPI_I2S_GetFlagStatus(SPI2,I2S_FLAG_CHSIDE)==0)
			{
				AK_Left_Data[RxLeftIdx]=temp;
				RxLeftIdx++;
			}
			//如果为右声道
			else
			{
				AK_Right_Data[RxRightIdx]=temp;
				RxRightIdx++;
			}
			//语音芯片数据计数器
			//如果数据采集完毕
			if(RxRightIdx>=DataLength*2 && RxLeftIdx>=DataLength*2)
			{
				//关闭I2S 中断
				SPI_I2S_ITConfig(SPI2, SPI_I2S_IT_RXNE, DISABLE);
				LastCh=-1;
			}
		}
	}
}
//这么基础的C语言知识都忘了！
//c语言的static在使用位置不同时是不同的，在全局上使用，表明该变量只能在本文件使用，在函数中使用，表该变量固定占据一个内存，且初始值在编译时决定，所以再次进入函数时，该变量不会重新被初始化且保留上一次退出函数的值。	

/*******************************************************************************
Timer2 用于汽缸电机中断
*******************************************************************************/
void TIM2_IRQHandler(void)
{ 
	static u8 pulsetype;
	if(TIM_GetFlagStatus(TIM2,TIM_FLAG_Update)!=RESET)
	{
		GPIO_WriteBit(GPIO_M1CL, GPIO_Pin_M1CL,(BitAction)pulsetype);
		pulsetype=~pulsetype;
		
		//如果脉冲够数
		if(PulseCount>=PulseNum+AddedNum)
		{
			//关闭中断及timer2
			TIM_ITConfig(TIM2, TIM_IT_Update, DISABLE);
			TIM_Cmd(TIM2,DISABLE);
		}
		//加压有加减速
		if(flagPress)
		{
			//如果出于匀速运行阶段
			if(PulseCount>294&&PulseCount<=PulseNum-294)
				TIM2->ARR=1157;
			//如果处于加速阶段
			else if(PulseCount<294)
				TIM2->ARR=moto_ac[PulseCount/2];
			//如果出于减速阶段
			else if((PulseNum-PulseCount)<294&&(PulseNum-PulseCount)>0)
				TIM2->ARR=moto_ac[(PulseNum-PulseCount)/2];
			//如果是AddedNum 部分，最低速度运行
			else
				TIM2->ARR=moto_ac[0];				
		}
		else
		{	//匀速
			if(StartSpeed==TargeSpeed)
			{
				TIM2->ARR=1157;
			}
			else
			{
				//不加压有加减速
				//如果出于匀速运行阶段
				if(PulseCount>324&&PulseCount<=PulseNum-324)
					TIM2->ARR=556;
				//如果处于加速阶段
				else if(PulseCount<324)
					TIM2->ARR=Speedup_moto[PulseCount/2];
				//如果出于减速阶段
				else if((PulseNum-PulseCount)<324&&(PulseNum-PulseCount)>0)
					TIM2->ARR=Speedup_moto[(PulseNum-PulseCount)/2];
				//如果是AddedNum 部分，最低速度运行
				else
					TIM2->ARR=Speedup_moto[0];	
			}
		}
		PulseCount++;
		TIM_ClearITPendingBit(TIM2, TIM_IT_Update);	
	}
}	

/***************************** END OF FILE *********************************/
